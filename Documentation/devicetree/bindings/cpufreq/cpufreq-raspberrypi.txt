## Documentation/devicetree/bindings/cpufreq/cpufreq-raspberrypi.txt
```
Binding for Raspberry Pi's CPUFreq driver
=====================================

Raspberry Pi's cpufreq driver controls the SoC's performance through a custom
firmware interface. All CPUs are synchronised together, yet the interface might
trigger changes on other unrelated clocks, which the driver takes care of
refreshing.

Properties:
- clocks: A list of phandle + clock-specifier pairs for the clocks listed in clock names.

- clock-names: Should contain the following:
	"plla"		- Video decoding and DSI clocks
	"pllb"		- ARM CPU's clock
	"pllc"		- VPU and EMMC clocks
	"vpu"		- VPU clock, used to notify peers
	Please refer to Documentation/devicetree/bindings/clock/clock-bindings.txt for
	generic clock consumer properties.

Example (Raspberry Pi 3-B):

	firmware: firmware {
		cpufreq {
			compatible = "raspberrypi,cpufreq";
			clocks = <&clocks BCM2835_PLLA>,
				 <&clocks BCM2835_PLLB>,
				 <&clocks BCM2835_PLLC>,
				 <&clocks BCM2835_CLOCK_VPU>;
			clock-names = "plla", "pllb", "pllc", "vpu";
		};
	};
```

## Documentation/devicetree/bindings/gpu/brcm,bcm-v3d.yaml
```yaml
# SPDX-License-Identifier: GPL-2.0-only
%YAML 1.2
---
$id: http://devicetree.org/schemas/gpu/brcm,bcm-v3d.yaml#
$schema: http://devicetree.org/meta-schemas/core.yaml#

title: Broadcom V3D GPU

maintainers:
  - Eric Anholt <eric@anholt.net>
  - Nicolas Saenz Julienne <nsaenzjulienne@suse.de>

properties:
  $nodename:
    pattern: '^gpu@[a-f0-9]+$'

  compatible:
    enum:
      - brcm,7268-v3d
      - brcm,7278-v3d
      - brcm,bcm2711-v3d

  reg:
    minItems: 2
    maxItems: 4

  reg-names:
    items:
      enum: [ hub, core0, bridge, gca ]
    minItems: 2
    maxItems: 4

  interrupts:
    minItems: 1
    maxItems: 2

  clocks:
    maxItems: 1

  resets:
    maxItems: 1

  power-domains:
    maxItems: 1

required:
  - compatible
  - reg
  - reg-names
  - interrupts

additionalProperties: false

examples:
  - |
    #include <dt-bindings/interrupt-controller/arm-gic.h>
    #include <dt-bindings/soc/bcm2835-pm.h>

    gpu@7ec04000 {
      compatible = "brcm,bcm2711-v3d";
      reg = <0x7ec00000 0x4000>,
            <0x7ec04000 0x4000>;
      reg-names = "hub", "core0";
      clocks = <&firmware_clocks 5>;
      interrupts = <GIC_SPI 74 IRQ_TYPE_LEVEL_HIGH>;
      power-domains = <&pm BCM2835_POWER_DOMAIN_GRAFX_V3D>;
      resets = <&pm BCM2835_RESET_V3D>;
    };

...
```

## Documentation/devicetree/bindings/media/brcm,bcm2835-unicam.yaml
```yaml
# SPDX-License-Identifier: (GPL-2.0-only OR BSD-2-Clause)
# Copyright (C) 2020 Raspberry Pi (Trading) Ltd.
%YAML 1.2
---
$id: http://devicetree.org/schemas/media/brcm,bcm2835-unicam.yaml#
$schema: http://devicetree.org/meta-schemas/core.yaml#

title: Broadcom BCM283x Camera Interface (Unicam)

maintainers:
  - Dave Stevenson <dave.stevenson@raspberrypi.com>
  - Raspberry Pi kernel list <kernel-list@raspberrypi.com>

description:
  The Unicam block on BCM283x SoCs is the receiver for either CSI-2 or CCP2
  data from image sensors or similar devices.

  The main platform using this SoC is the Raspberry Pi family of boards. On the
  Pi the VideoCore firmware can also control this hardware block, and driving
  it from two different processors will cause issues. To avoid this, the
  firmware checks the device tree configuration during boot. If it finds device
  tree nodes whose name starts with "csi" then it will stop the firmware
  accessing the block, and it can then safely be used via the device tree
  binding.

properties:
  compatible:
    const: brcm,bcm2835-unicam

  reg:
    items:
      - description: Main registers block
      - description: Clock registers block

  interrupts:
    maxItems: 1

  clocks:
    minItems: 1
    maxItems: 2

  clock-names:
    minItems: 1
    items:
      - const: lp
      - const: core

  power-domains:
    maxItems: 1

  brcm,num-data-lanes:
    description:
      The number of data lanes supported by this Unicam instance. It may be
      larger than the number of data lanes routed on the board, as described by
      the data-lanes property of the endpoint.
    allOf:
      - $ref: "/schemas/types.yaml#/definitions/uint32"
      - enum: [1, 2, 4]

  port:
    type: object
    description:
      Input port node, as described in video-interfaces.txt.

    properties:
      endpoint:
        type: object

        properties:
          clock-lanes:
            items:
              - const: 0

          data-lanes:
            description:
              Lane reordering is not supported, items shall be in order,
              starting at 1.
            allOf:
              - $ref: "/schemas/types.yaml#/definitions/uint32-array"
              - maxItems: 1
                items:
                  minItems: 1
                  maxItems: 4
                  items:
                    - const: 1
                    - const: 2
                    - const: 3
                    - const: 4

          lane-polarities:
            description:
              Lane inversion is not supported. If the property is specified, it
              shall contain all 0's.
            allOf:
              - $ref: "/schemas/types.yaml#/definitions/uint32-array"
              - maxItems: 1
                items:
                  minItems: 2
                  maxItems: 5
                  items:
                    - const: 0
                    - const: 0
                    - const: 0
                    - const: 0
                    - const: 0

          remote-endpoint: true

        required:
          - data-lanes
          - remote-endpoint

        additionalProperties: false

    required:
      - endpoint

    additionalProperties: false

required:
  - compatible
  - reg
  - interrupts
  - clocks
  - clock-names
  - power-domains
  - brcm,num-data-lanes
  - port

additionalProperties: false

examples:
  - |
    #include <dt-bindings/clock/bcm2835.h>
    #include <dt-bindings/interrupt-controller/arm-gic.h>
    #include <dt-bindings/power/raspberrypi-power.h>

    csi@7e801000 {
        compatible = "brcm,bcm2835-unicam";
        reg = <0x7e801000 0x800>,
              <0x7e802004 0x4>;
        interrupts = <2 7>;
        clocks = <&clocks BCM2835_CLOCK_CAM1>;
        clock-names = "lp";
        power-domains = <&power RPI_POWER_DOMAIN_UNICAM1>;
        brcm,num-data-lanes = <4>;

        port {
            csi1_ep: endpoint {
                remote-endpoint = <&imx219_0>;
                data-lanes = <1 2>;
            };
        };
    };
...
```

## Documentation/devicetree/bindings/nvmem/rmem.yaml
```yaml
# SPDX-License-Identifier: (GPL-2.0-only OR BSD-2-Clause)
%YAML 1.2
---
$id: http://devicetree.org/schemas/nvmem/rmem.yaml#
$schema: http://devicetree.org/meta-schemas/core.yaml#

title: Reserved Memory Based nvmem Device

maintainers:
  - Nicolas Saenz Julienne <nsaenzjulienne@suse.de>

properties:
  compatible:
    enum:
      - nvmem-rmem

  memory-region:
    $ref: /schemas/types.yaml#/definitions/phandle
    description:
      phandle to the reserved memory region

required:
  - compatible
  - memory-region

additionalProperties: false

examples:
  - |
        fw-config {
                compatible = "nvmem-rmem";
                memory-region = <&mem>;
        };

...
```

## Documentation/devicetree/bindings/pci/brcmstb-pcie.txt
```
Brcmstb PCIe Host Controller Device Tree Bindings

Required Properties:
- compatible
  "brcm,bcm2711-pcie" -- for the Raspberry Pi 4.

- reg -- the register start address and length for the PCIe reg block.
- interrupts -- two interrupts are specified; the first interrupt is for
     the PCI host controller and the second is for MSI if the built-in
     MSI controller is to be used.
- interrupt-names -- names of the interrupts (above): "pcie" and "msi".
- #address-cells -- set to <3>.
- #size-cells -- set to <2>.
- #interrupt-cells: set to <1>.
- interrupt-map-mask and interrupt-map, standard PCI properties to define the
     mapping of the PCIe interface to interrupt numbers.
- ranges: ranges for the PCI memory and I/O regions.
- linux,pci-domain -- should be unique per host controller.
- dma-ranges -- Specifies the inbound memory mapping regions when
     an "identity map" is not possible.

Optional Properties:
- clocks -- phandle of pcie clock.
- clock-names -- set to "sw_pcie" if clocks is used.
- msi-controller -- this property is typically specified to have the
     PCIe controller use its internal MSI controller.
- msi-parent -- set to use an external MSI interrupt controller.
- brcm,enable-ssc -- (boolean) indicates usage of spread-spectrum clocking.
- max-link-speed --  (integer) indicates desired generation of link:
     1 => 2.5 Gbps (gen1), 2 => 5.0 Gbps (gen2), 3 => 8.0 Gbps (gen3).

Example Node:

	pcie0: pcie@7d500000 {
		compatible = "brcm,bcm2711-pcie";
		reg = <0x0 0x7d500000 0x9310>;
		#address-cells = <3>;
		#size-cells = <2>;
		#interrupt-cells = <1>;
		interrupts = <GIC_SPI 148 IRQ_TYPE_LEVEL_HIGH>,
			     <GIC_SPI 148 IRQ_TYPE_LEVEL_HIGH>;
		interrupt-names = "pcie", "msi";
		interrupt-map-mask = <0x0 0x0 0x0 0x7>;
		interrupt-map = <0 0 0 1 &gicv2 GIC_SPI 143 IRQ_TYPE_LEVEL_HIGH
				 0 0 0 2 &gicv2 GIC_SPI 144 IRQ_TYPE_LEVEL_HIGH
				 0 0 0 3 &gicv2 GIC_SPI 145 IRQ_TYPE_LEVEL_HIGH
				 0 0 0 4 &gicv2 GIC_SPI 146 IRQ_TYPE_LEVEL_HIGH>;
		msi-parent = <&pcie_0>;
		msi-controller;
		ranges = <0x02000000 0x0 0xf8000000 0x6 0x00000000 0x0 0x04000000>;
		dma-ranges = <0x02000000 0x0 0x00000000 0x0 0x00000000 0x0 0x80000000>;
		max-link-speed = <2>;
		brcm,enable-ssc;
		linux,pci-domain = <0>;
	};
```
